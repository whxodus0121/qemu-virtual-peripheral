## br2-external/Config.in
```kconfig
menu "VPERIPH packages"

source "$BR2_EXTERNAL_VPERIPH_PATH/package/vperiph-driver/Config.in"
source "$BR2_EXTERNAL_VPERIPH_PATH/package/vperiph-cli/Config.in"

endmenu
```

## br2-external/package/vperiph-cli/Config.in
```kconfig
config BR2_PACKAGE_VPERIPH_CLI
    bool "vperiph-cli"
    depends on BR2_INSTALL_LIBSTDCPP
    help
      C++ user-space CLI for controlling the QEMU vperiph device.

comment "vperiph-cli needs a toolchain with C++ support"
    depends on !BR2_INSTALL_LIBSTDCPP
```

## br2-external/package/vperiph-driver/Config.in
```kconfig
config BR2_PACKAGE_VPERIPH_DRIVER
    bool "vperiph-driver"
    depends on BR2_LINUX_KERNEL
    help
      Linux platform driver for the QEMU vperiph device.

comment "vperiph-driver needs a Linux kernel to be built"
    depends on !BR2_LINUX_KERNEL
```
